## hw/dma/Kconfig
```kconfig
config RC4030
    bool

config PL080
    bool

config PL330
    bool

config I82374
    bool
    select I8257

config I8257
    bool

config ZYNQ_DEVCFG
    bool
    select REGISTER

config STP2000
    bool

config SIFIVE_PDMA
    bool

config INTEL_DW_DMA
    bool

config INTEL_DW_DMA_DSP
    bool

config INTEL_DW_DMA_PCI
    bool

config INTEL_HDA_DMA
    bool

config INTEL_HDA_DMA_DSP
    bool

config INTEL_HDA_DMA_PCI
    bool
```
